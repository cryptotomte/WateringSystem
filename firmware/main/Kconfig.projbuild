## firmware/main/Kconfig.projbuild
```kconfig
menu "WateringSystem"
    choice BOARD
        prompt "Board revision"
        default BOARD_REV1_DEVKIT
        config BOARD_REV1_DEVKIT
            bool "Rev 1 — ESP32 devkit + breakout (TXS0108E + SP3485)"
        config BOARD_REV2
            bool "Rev 2 — custom PCB (THVD1426 auto-direction, INA226, CP2102N)"
    endchoice

    config WS_INA226_SHUNT_MILLIOHM
        int "INA226 pump shunt resistance (milliohm)"
        depends on BOARD_REV2
        default 5
        range 1 1000
        help
            Shunt resistor value on the pump 12 V supply, in milliohms.
            The INA226 calibration register is derived from it at boot
            (CAL = 0.00512 / (Current_LSB x R_shunt), Current_LSB fixed at
            0.5 mA — 2048 at the default 5 mOhm, rev2 BOM R1 5 mOhm 2512).
            Only change this when the fitted shunt changes; the current
            resolution is a compile-time driver constant (research.md R9).

    config WS_PROV_AP_SSID
        string "Provisioning SoftAP SSID"
        default "WateringSystem-Setup"
        help
            SSID advertised by the first-boot SoftAP setup portal
            (feature 007). Shown to the operator during provisioning; not
            a secret.

    config WS_PROV_AP_PASSWORD
        string "Provisioning SoftAP password (WPA2)"
        default "change-me-setup"
        help
            WPA2 password for the first-boot provisioning SoftAP
            (feature 007). This is a DOCUMENTED NON-SECRET: it only shields
            the brief unconfigured-device window, and WPA2 is kept so the
            operator's real home-WiFi credentials are never sent in
            cleartext during setup (those live only in NVS). CHOOSE A NEW
            PASSWORD at build/deploy time — do NOT ship the placeholder and
            do NOT reuse the legacy AP password. Must be 8..63 characters
            for WPA2 (an empty value yields an open AP).

    config WS_WIFI_RETRY_INTERVAL_MS
        int "WiFi reconnect retry interval (ms)"
        default 10000
        range 1000 600000
        help
            Delay between STA connect attempts while reconnecting
            (parity default 10 s, docs/parity-checklist.md §7).

    config WS_WIFI_FAILS_BEFORE_PAUSE
        int "WiFi consecutive failures before long pause"
        default 5
        range 1 100
        help
            Consecutive failed connect attempts that trigger the long
            reconnect pause (parity default 5).

    config WS_WIFI_PAUSE_MS
        int "WiFi long reconnect pause (ms)"
        default 60000
        range 1000 3600000
        help
            Extra wait after WS_WIFI_FAILS_BEFORE_PAUSE consecutive
            failures before starting a fresh reconnect round (parity
            default 60 s). Never reboots (FR-013).

    config WS_WIFI_MONITOR_INTERVAL_MS
        int "WiFi connection-health monitor interval (ms)"
        default 5000
        range 500 600000
        help
            Health-check cadence while connected; suspended in
            provisioning/AP mode (parity default 5 s).

    config WS_SNTP_SERVER
        string "SNTP server hostname"
        default "se.pool.ntp.org"
        help
            NTP pool hostname queried once the WiFi station first reaches
            Connected (feature 008). The Swedish pool by default. SNTP runs
            outside the watering path and never blocks; failure to reach the
            server is non-fatal and retried by the SNTP service. Until the
            first successful sync the wall clock reports "time not set".

    config WS_TASK_WDT_TIMEOUT_S
        int "Task watchdog timeout (seconds)"
        default 20
        range 6 120
        help
            Timeout for the hardware task watchdog applied at runtime to the
            watering-critical tasks (the 10 Hz main loop and the sensor
            task; the WiFi task is deliberately NOT subscribed so a network
            stall cannot reboot the device). A non-serviced subscribed task
            triggers a panic reboot; pumps are forced OFF at boot and the
            reset reason is logged (feature 008). Keep a safe margin over the
            slowest critical-task cadence (the sensor task's 5 s cycle) so a
            healthy task is never falsely tripped — hence the >= 6 s floor
            and 20 s default.
endmenu
```

## firmware/sdkconfig.defaults
```kconfig
# WateringSystem base configuration (board-independent).
# Board selection is layered on top via sdkconfig.board.* overlays:
#   idf.py -DSDKCONFIG_DEFAULTS="sdkconfig.defaults;sdkconfig.board.rev1_devkit" build

# Chip target: ESP32-WROOM-32E
CONFIG_IDF_TARGET="esp32"

# Flash: 4MB
CONFIG_ESPTOOLPY_FLASHSIZE_4MB=y

# Custom partition table (A/B OTA + NVS + littlefs)
CONFIG_PARTITION_TABLE_CUSTOM=y
CONFIG_PARTITION_TABLE_CUSTOM_FILENAME="partitions.csv"

# OTA foundation: enable app rollback so a failed boot reverts to the
# previous app slot (full OTA support is added in a later phase).
CONFIG_BOOTLOADER_APP_ROLLBACK_ENABLE=y

# Logging: info level by default
CONFIG_LOG_DEFAULT_LEVEL_INFO=y

# Assertions: pinned to full assertions. LOAD-BEARING FOR SAFETY: parts of
# the boot path (and IDF-internal checks) rely on assert/ESP_ERROR_CHECK;
# disabling assertions (NDEBUG) silently turns those checks into no-ops.
# Never switch this to SILENT/DISABLE for "production" builds.
CONFIG_COMPILER_OPTIMIZATION_ASSERTIONS_ENABLE=y

# Task watchdog (feature 008): initialise the hardware task WDT at startup
# and panic (reboot) on timeout, so a hung watering-critical task forces a
# safe reboot (pumps OFF at boot + reset reason logged). The watering tasks
# are subscribed at runtime (task_watchdog helper); the WiFi task is
# deliberately left unsubscribed. The effective timeout is driven from code
# via CONFIG_WS_TASK_WDT_TIMEOUT_S (esp_task_wdt_reconfigure at init), so the
# IDF init timeout below is left at its default and not overridden here.
CONFIG_ESP_TASK_WDT_INIT=y
CONFIG_ESP_TASK_WDT_PANIC=y
```

## firmware/test_apps/host/sdkconfig.defaults
```kconfig
# Host test app (linux preview target).
#
# A custom partition table provides the `nvs` partition that the linux
# esp_partition emulation exposes to the real nvs_flash implementation
# (research.md D3 of 003-nvs-littlefs-storage).
CONFIG_PARTITION_TABLE_CUSTOM=y
CONFIG_PARTITION_TABLE_CUSTOM_FILENAME="partitions_host.csv"
```
